## projects/ad7866-admt4000/Kconfig
```kconfig
menu "ad7866-admt4000 Configuration"

config AD7866_ADMT4000_IIO_TRIGGER_EXAMPLE
	bool "IIO Trigger example"
	depends on IIO && IRQ
	default y

config PCL_VERSION
	string "precision-converters-library version tag/commit"
	default "7af7d492b075538d11534f0db11e005c930b804c"
	depends on AD7866_ADMT4000_IIO_TRIGGER_EXAMPLE
	help
	  Git tag, branch or commit for precision-converters-library.
	  Resolved via the NO_OS_DEP_PCL_PATH override, else cloned in-tree
	  (or into a version-keyed NO_OS_CACHE_DIR store when that is set).

endmenu
```

## projects/ad7866/Kconfig
```kconfig
menu "ad7866 Configuration"

choice AD7866_EXAMPLE
	prompt "Example variant"
	default AD7866_BASIC_EXAMPLE

config AD7866_BASIC_EXAMPLE
	bool "Basic example"

config AD7866_IIO_EXAMPLE
	bool "IIO example"
	depends on IIO

endchoice

endmenu
```
